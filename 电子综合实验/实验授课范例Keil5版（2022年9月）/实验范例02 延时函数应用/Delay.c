/*
	功能：LED闪烁（周期1秒），蜂鸣器操作类似。
	1、利用软件计数方式得1ms延时效果
  2、利用定时查询方式得1ms延时效果
	跳线连接：实验板上JP2的“流水灯”跳线短接
	编制：电子科技大学实验中心2022年6月
*/


#include <reg52.h>	// 包含8051的SFR寄存器定义头文件

//实验板上D1到D8有8个发光二极管，分别对应IO口P1^0到P1^7
//跳线连接：智能小车实验板上JP2的“流水灯”跳线短接

sbit LED1 = P1^0;			//定义LED由P1.0控制
sbit BUZZER = P2^3;		//定义BUZZER由P2.3控制
/*
函数：Delayms_1()
功能：延时
说明：
	晶振频率为11.0592MHz
	延时长度 = 1ms * t
*/
void Delayms_1(unsigned int t)		//经常使用该函数做延时函数
{
	unsigned int us_ct;
	for (;t > 0;t --)		//执行代码消耗CPU时间
		for (us_ct = 113;us_ct > 0;us_ct --);	
}

/*
函数：Delayms_2()
功能：延时
说明：
  借助该实验理解定时器的使用方法，为下一个定时中断做铺垫
	晶振频率为11.0592MHz,延时长度 = 1ms * t
	定时1ms的定时器初值=65536-0.001/(1/(f/12))=64614=0xFC66，其中f为晶振频率(Hz)
*/
void Delayms_2(unsigned int t)		//理解为主，为下一个定时中断做铺垫
{
	do
	{
		TH0 = 0xFC;		//设置定时器初值高字节（对应0.001s）
		TL0 = 0x66;		//设置定时器初值低字节（对应0.001s）
		TR0 = 1;			//启动定时器
		while ( !TF0 );	//等待定时器溢出TF0为T0的溢出标志
		TR0 = 0;			//停止定时器
		TF0 = 0;			//清除溢出标志
	} while ( --t != 0 );	//循环t次
}
//主函数//
void main()
{
	TMOD = 0x01;	//将定时器T0设置为方式1，即16位定时器
	while(1)
	{	
		LED1 = 0;					//点亮LED（低电平点亮）
		BUZZER = 0;				//蜂鸣器响（低电平有效）
		Delayms_1(100);		//延时100ms

		LED1 = 1;					//熄灭
		BUZZER = 1;				//蜂鸣器停
		Delayms_2(900);		//延时900ms
	}
}
