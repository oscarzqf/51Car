/*
	功能：通过定时器中断，控制蜂鸣器（板上为有源蜂鸣器）发声，同时实现一个"秒指示灯"。
	定时中断计数值代表了定时时间的倍数，即定时时长的统计，由此得到新的时间。
	例如范例中每1000次定时1ms的统计代表了1秒。
	注意：定时器的应用；定时中断的应用。
	编制：电子科技大学实验中心2022年6月
*/


#include <reg52.h>

//智能小车
sbit BUZZER = P2^3;	//有源蜂鸣器驱动端口，低电平输出响
sbit LED1 = P1^0;		//定义LED1由P1.0控制
sbit LED2 = P1^1;		//定义LED2由P1.1控制

/*通常定义一个全局bit量用于逻辑控制标志*/
bit flag_1s = 0;		//1秒标志位

/*
函数：T1INTSVC()
功能：定时器T1的中断服务函数
说明：
	晶振频率为11.0592MHz
	定时器初值＝65536-(f0/12)/(2*fx)，其中f0为晶振频率，fx为发声频率，TH = 0xFC;TL = 0x66对应定时时间1ms
*/
void T1INTSVC() interrupt 3	//定时器1的中断号为3；若为定时器0，其中断号为1
{
	static unsigned int counter_1ms = 0;	//为什么变量定义为static类型呢？

	TR1 = 0;			//暂时停止定时器（在重新设置初值之前必须暂停）
	TH1 = 0xFC;		//重装初值		
	TL1 = 0x66;
	TR1 = 1;			//重新启动定时器

//=============以下程序可用于声光报警=================
	counter_1ms ++;
	if(counter_1ms == 1000)
	{
		counter_1ms = 0;	//输出的信号周期为1秒
		flag_1s = 1;
	}
	if(counter_1ms <= 100)
	{
		LED1 = 0;
		BUZZER = 0;		//如果不用声报警，该语句屏蔽
	}
	else
	{
		LED1 = 1;
		BUZZER = 1;		
	}
}


//主程序
void main()
{	
	TMOD = 0x11;	//设置定时器T0为16位定时器，定时器T1为16位定时器
	TH1 = 0xFC;		//设置定时器1的初值: 0xFC66，对应定时时间1ms
	TL1 = 0x66;
	
	ET1 = 1;		//使能定时器T1中断
	EA = 1;			//使能总中断
	TR1 = 1;		//启动定时器T1

	while(1)
	{
		if (flag_1s)
		{
			flag_1s = 0;
			LED2 = !LED2;
		}
	}
}
//思考：为什么声光报警的程序放在定时中断？如果放在主函数中呢？

